/* SPDX-License-Identifier: MIT */
/* GENERATED by loaders/stm32u5/build.py from loaders/stm32u5/u5_flash_ldr.c - do not edit.
 * arm-none-eabi-gcc (Arm GNU Toolchain 15.3.Rel2 (Build arm-15.181)) 15.3.1 20260627; verified in unicorn against a model of the STM32U5 FLASH registers. */
#define ESW_U5LDR_WORDS 357u
#define ESW_U5LDR_OFF_TRAP 0x00u
#define ESW_U5LDR_OFF_STREAM 0x08u   /* even offsets: Thumb state comes from xPSR.T */
#define ESW_U5LDR_TAB 0x1000u
#define ESW_U5LDR_MAILBOX 0x1400u
#define ESW_U5LDR_STACK_TOP 0x2000u
#define ESW_U5LDR_BUF 0x2000u
#define ESW_U5LDR_RAM 0x6000u
static const uint32_t esw_u5_ldr_blob[ESW_U5LDR_WORDS] = {
    0xF7FFBE00u, 0xBF00BFFDu, 0x4FF0E92Du, 0xF5002500u, 0xB0976340u, 0x46814CC1u,
    0x6A80F5A0u, 0xF2A09306u, 0x462A4004u, 0xF3422108u, 0x40230300u, 0xEA833901u,
    0xD1F80252u, 0xF5B53501u, 0xF8407F80u, 0xD1F02F04u, 0xF64F4BB7u, 0xF8D372FFu,
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    0xFFFFFFFFu, 0xFFFFFFFFu, 0xFFFFFFFFu,
};
